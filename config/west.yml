## config/west.yml
```yaml
manifest:
  remotes:
    - name: zmkfirmware
      url-base: https://github.com/zmkfirmware
    - name: infused-kim
      url-base: https://github.com/infused-kim
    - name: matuck
      url-base: https://github.com/matuck
    - name: petejohanson
      url-base: https://github.com/petejohanson/
  projects:
    - name: zmk
      remote: zmkfirmware
      revision: main
      #remote: matuck
      #revision: sofle
      import: app/west.yml
  self:
    path: config
```
